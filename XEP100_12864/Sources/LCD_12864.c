
/**********************(c) Copyright 20017-2018, CIDI **********************
	File： LCD_12864.c
	Description：  12864 LCD液晶模块配置文件
    Code Warrior 5.0
    Target : MC9S12XEP100
    Crystal: 16.000Mhz
    busclock:16.000MHz
    pllclock:32.000MHz

    硬件平台 龙丘MC9S12XEP100多功能开发板 

    Author：wllis
    Date: 04/17/2018
      
    Note:
  
  Version: 1.0

**************************************************************************/

#include "derivative.h"
#include "LCD_12864.h"

#define LCD_Data_Dir	DDRA
#define LCD_Data_Out	PORTA
#define LCD_SDA 0x10  //PA4(MOSI)
#define LCD_SCL	0x08  //PA3(SCK)
#define LCD_CD	0x04  //PA2(A0:0-cmd;1-data)
#define LCD_RST	0x02  //PA1(RESET)
#define LCD_CS	0x01  //PA0(CS)  

#define X_WIDTH 128
#define Y_WIDTH 64
//======================================
const byte F6x8[][6] =
{
    { 0x00, 0x00, 0x00, 0x00, 0x00, 0x00 },   // sp
    { 0x00, 0x00, 0x00, 0x2f, 0x00, 0x00 },   // !
    { 0x00, 0x00, 0x07, 0x00, 0x07, 0x00 },   // "
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    { 0x14, 0x14, 0x14, 0x14, 0x14, 0x14 }    // horiz lines
};
const byte F14x16_Idx[] = 
{
	"龙丘科技开发板智能车接收发送节点地址数据本室温度按键次电压"
};
const byte F14x16[] = {  
  0x10,0x10,0x10,0x10,0x90,0x7E,0x10,0xF0,0x12,0x14,0xD8,0x10,0x10,0x00,
  0x20,0x10,0x08,0x06,0x11,0x10,0x08,0x1F,0x22,0x21,0x20,0x20,0x1C,0x00,//龙0
  0x00,0x00,0xF8,0x88,0x88,0x88,0x84,0x84,0x82,0x82,0x80,0x80,0x00,0x00,
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  0x38,0x07,0x20,0x20,0x20,0x20,0x20,0x3F,0x20,0x22,0x24,0x2C,0x20,0x00,//压7

 
};

//======================================================
// 128X64I液晶底层驱动[8X16]字体库
// 设计者: powerint
// 描  述: [8X16]西文字符的字模数据 (纵向取模,字节倒序)
// !"#$%&'()*+,-./0123456789:;<=>?@ABCDEFGHIJKLMNOPQRSTUVWXYZ[\]^_`abcdefghijklmnopqrstuvwxyz{|}~
//======================================================
const byte F8X16[]=
{
	0x00,0x00,0x00,0x00,0x00,0x00,0x00,0x00,0x00,0x00,0x00,0x00,0x00,0x00,0x00,0x00,// 0
  0x00,0x00,0x00,0xF8,0x00,0x00,0x00,0x00,0x00,0x00,0x00,0x33,0x30,0x00,0x00,0x00,//!1
  0x00,0x10,0x0C,0x06,0x10,0x0C,0x06,0x00,0x00,0x00,0x00,0x00,0x00,0x00,0x00,0x00,//"2
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  0x00,0x06,0x01,0x01,0x02,0x02,0x04,0x04,0x00,0x00,0x00,0x00,0x00,0x00,0x00,0x00,//~94

};
const byte LIBLOGO60x58[480] = { 
  0X00,0X00,0X00,0X00,0X00,0X00,0X00,0X00,0X00,0X00,0X00,0X00,0X00,0X00,0X00,0X00,
  0X00,0X00,0X00,0X00,0X00,0X00,0X00,0X00,0X00,0X00,0X00,0X00,0X00,0X00,0X00,0X00,
  0X00,0X00,0X00,0X00,0X00,0X00,0X00,0X00,0X00,0X00,0X00,0X00,0X00,0X00,0X00,0X00,
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  0X00,0X00,0X00,0X00,0X00,0X00,0X00,0X00,0X00,0X00,0X00,0X00,0X00,0X00,0X00,0X00,
}; 
/*******************************************************************************
* Function Name  : LCD_WrDat
* Description    : 液晶模块写数据函数
* Input          : 字节型数据
* Output         : None
* Return         : None
*******************************************************************************/
void LCD_WrDat(byte data)
{
    byte i=8;
    LCD_Data_Out &= ~LCD_CS;
    LCD_Data_Out |= LCD_CD;
    LCD_Data_Out&=~LCD_SCL;
    //asm("nop");    
    while(i--)
    {
        if(data&0x80){LCD_Data_Out|=LCD_SDA;}
        else{LCD_Data_Out&=~LCD_SDA;}
        LCD_Data_Out|=LCD_SCL; 
        asm("nop");
        //asm("nop");            
        LCD_Data_Out&=~LCD_SCL;    
        data<<=1;    
    }
    LCD_Data_Out |= LCD_CS; 
}
/*******************************************************************************
* Function Name  : LCD_WrCmd
* Description    : 液晶模块写命令函数
* Input          : 字节型命令
* Output         : None
* Return         : None
*******************************************************************************/
void LCD_WrCmd(byte cmd)
{
    byte i=8;

    LCD_Data_Out &= ~LCD_CS;
    LCD_Data_Out &= ~LCD_CD;
    LCD_Data_Out&=~LCD_SCL;
    //asm("nop");   
    while(i--)
    {
        if(cmd&0x80){LCD_Data_Out|=LCD_SDA;}
        else{LCD_Data_Out&=~LCD_SDA;}
        LCD_Data_Out|=LCD_SCL;
        asm("nop");
        //asm("nop");             
        LCD_Data_Out&=~LCD_SCL;    
        cmd<<=1;   
    } 	
    LCD_Data_Out |= LCD_CS; 
}
void LCD_Set_Pos(byte x, byte y)
{ 
    LCD_WrCmd(0xb0+y);
    LCD_WrCmd(((x&0xf0)>>4)|0x10);
    LCD_WrCmd((x&0x0f)|0x01); 
} 
void LCD_Fill(byte bmp_data)
{
    byte y,x;

    for(y=0;y<8;y++)
    {
        LCD_WrCmd(0xb0+y);
        LCD_WrCmd(0x01);
        LCD_WrCmd(0x10);
        for(x=0;x<X_WIDTH;x++)
        LCD_WrDat(bmp_data);
    }
}
void LCD_CLS(void)
{
    byte y,x;	
    for(y=0;y<8;y++)
    {
        LCD_WrCmd(0xb0+y);
        LCD_WrCmd(0x01);
        LCD_WrCmd(0x10); 
        for(x=0;x<X_WIDTH;x++)
        LCD_WrDat(0);
    }
}
void LCD_DLY_ms(word ms)
{                         
    word a;
    while(ms)
      {
        a=1335;
        while(a--);
        ms--;
    }
    return;
}

void LCD_Init(void)        
{
    LCD_Data_Dir |= 0xff;
    LCD_Data_Out |= LCD_SCL+LCD_CS;	//预制SLK和SS为高电平   	
    
    LCD_Data_Out &= ~LCD_RST;
    LCD_DLY_ms(50);
    LCD_Data_Out |= LCD_RST;
    LCD_DLY_ms(20); 	
    LCD_WrCmd(0xaf);	//0xaf  LCD On
    LCD_WrCmd(0x2f);	//0x2f  设置上电控制模式  	
    LCD_WrCmd(0x60);	//0x81  电量设置模式（显示亮度）
    LCD_WrCmd(0x10);	//指令数据0x0000~0x003f  	
    LCD_WrCmd(0x24);	//0x24  V5内部电压调节电阻设置
    LCD_WrCmd(0xa2);	//0xa2 5V,0xa1 3V3     LCD偏压设置   	
    LCD_WrCmd(0xc0);	//0xc8 正常,0xc0 倒置  Com 扫描方式设置
    LCD_WrCmd(0xa1);	//0xa0 正常,0xa1 反向  Segment方向选择
    LCD_WrCmd(0xa4);	//0xa4  全屏点亮/变暗指令
    LCD_WrCmd(0xa6);	//0xa6  正向反向显示控制指令   	
    LCD_WrCmd(0xac);	//0xac  关闭静态指示器
    LCD_WrCmd(0x00);	//指令数据    	
    LCD_WrCmd(0x40+32);	//0x40+32	设置显示起始行对应RAM
    LCD_Fill(0x00);  //初始清屏
    LCD_Set_Pos(0,0); 	
} 
//==============================================================
//函数名： void LCD_PutPixel(byte x,byte y)
//功能描述：绘制一个点（x,y）
//参数：真实坐标值(x,y),x的范围0～127，y的范围0～64
//返回：无
//==============================================================
void LCD_PutPixel(byte x,byte y)
{
    byte data1;  //data1当前点的数据 
    
    LCD_Set_Pos(x,y); 
    data1 = 0x01<<(y%8); 	
    LCD_WrCmd(0xb0+(y>>3));
    LCD_WrCmd(((x&0xf0)>>4)|0x10);
    LCD_WrCmd((x&0x0f)|0x00);
    LCD_WrDat(data1); 	 	
}
//==============================================================
//函数名： void LCD_Rectangle(byte x1,byte y1,
//                   byte x2,byte y2,byte color,byte gif)
//功能描述：绘制一个实心矩形
//参数：左上角坐标（x1,y1）,右下角坐标（x2，y2）
//      其中x1、x2的范围0～127，y1，y2的范围0～63，即真实坐标值
//返回：无
//==============================================================
void LCD_Rectangle(byte x1,byte y1,byte x2,byte y2,byte gif)
{
    byte n; 
		
    LCD_Set_Pos(x1,y1>>3);
    for(n=x1;n<=x2;n++)
    {
        LCD_WrDat(0x01<<(y1%8)); 			
        if(gif == 1) 	LCD_DLY_ms(50);
    }  
    LCD_Set_Pos(x1,y2>>3);
    for(n=x1;n<=x2;n++)
    {
        LCD_WrDat(0x01<<(y2%8)); 			
        if(gif == 1) 	LCD_DLY_ms(5);
    }
	
}  
//==============================================================
//函数名：LCD_P6x8Str(byte x,byte y,byte *p)
//功能描述：写入一组标准ASCII字符串
//参数：显示的位置（x,y），y为页范围0～7，要显示的字符串
//返回：无
//==============================================================  
void LCD_P6x8Str(byte x,byte y,byte ch[])
{
    byte c=0,i=0,j=0;      
    while (ch[j]!='\0')
    {    
        c =ch[j]-32;
        if(x>122){x=0;y++;}
        LCD_Set_Pos(x,y);    
        for(i=0;i<6;i++)     
            LCD_WrDat(F6x8[c][i]);  
        x+=6;
        j++;
    }
}
//==============================================================
//函数名：LCD_P8x16Str(byte x,byte y,byte *p)
//功能描述：写入一组标准ASCII字符串
//参数：显示的位置（x,y），y为页范围0～7，要显示的字符串
//返回：无
//==============================================================  
void LCD_P8x16Str(byte x,byte y,byte ch[])
{
    byte c=0,i=0,j=0;
          
    while (ch[j]!='\0')
    {    
        c =ch[j]-32;
        if(x>120){x=0;y++;}
        LCD_Set_Pos(x,y);    
        for(i=0;i<8;i++)     
            LCD_WrDat(F8X16[c*16+i]);
        LCD_Set_Pos(x,y+1);    
        for(i=0;i<8;i++)     
            LCD_WrDat(F8X16[c*16+i+8]);  
        x+=8;
        j++;
    }
}
//输出汉字字符串
void LCD_P14x16Str(byte x,byte y,byte ch[])
{
    byte wm=0,ii = 0;
    word adder=1; 
    
    while(ch[ii] != '\0')
    {
        wm = 0;
        adder = 1;
        while(F14x16_Idx[wm] > 127)
        {
            if(F14x16_Idx[wm] == ch[ii])
            {
                if(F14x16_Idx[wm + 1] == ch[ii + 1])
                {
                    adder = wm * 14;
                    break;
                }
            }
            wm += 2;			
        }
        if(x>114){x=0;y++;}
        LCD_Set_Pos(x , y); 
        if(adder != 1)// 显示汉字					
        {
            LCD_Set_Pos(x , y);
            for(wm = 0;wm < 14;wm++)               
            {
                LCD_WrDat(F14x16[adder]);	
                adder += 1;
            }      
            LCD_Set_Pos(x,y + 1); 
            for(wm = 0;wm < 14;wm++)          
            {
                LCD_WrDat(F14x16[adder]);
                adder += 1;
            }   		
        }
        else			  //显示空白字符			
        {
            ii += 1;
            LCD_Set_Pos(x,y);
            for(wm = 0;wm < 16;wm++)
            {
                LCD_WrDat(0);
            }
            LCD_Set_Pos(x,y + 1);
            for(wm = 0;wm < 16;wm++)
            {   		
                LCD_WrDat(0);	
            }
        }
        x += 14;
        ii += 2;
    }
}
//输出汉字和字符混合字符串
void LCD_Print(byte x, byte y, byte ch[])
{
	byte ch2[3];
	byte ii=0;        
	while(ch[ii] != '\0')
	{
		if(ch[ii] > 127)
		{
			ch2[0] = ch[ii];
	 		ch2[1] = ch[ii + 1];
			ch2[2] = '\0';			//汉字为两个字节
			LCD_P14x16Str(x , y, ch2);	//显示汉字
			x += 14;
			ii += 2;
		}
		else
		{
			ch2[0] = ch[ii];	
			ch2[1] = '\0';			//字母占一个字节
			LCD_P8x16Str(x , y , ch2);	//显示字母
			x += 8;
			ii+= 1;
		}
	}
} 

//==============================================================
//函数名： void Draw_BMP(byte x,byte y)
//功能描述：显示BMP图片128×64
//参数：起始点坐标(x,y),x的范围0～127，y为页的范围0～7
//返回：无
//==============================================================
void Draw_BMP(byte x0,byte y0,byte x1,byte y1,byte bmp[])
{ 	
  word ii=0;
  byte x,y;
  
  if(y1%8==0) y=y1/8;      
  else y=y1/8+1;
	for(y=y0;y<=y1;y++)
	{
		LCD_Set_Pos(x0,y);				
    for(x=x0;x<x1;x++)
	    {      
	    	LCD_WrDat(bmp[ii++]);	    	
	    }
	}
}

void Draw_LibLogo(void)
{ 	
  word ii=0;
  byte x,y;       
  
	for(y=0;y<8;y++)
	{
		LCD_Set_Pos(34,y);				
    for(x=34;x<94;x++)
	    {      
	    	LCD_WrDat(LIBLOGO60x58[ii++]);	    	
	    }
	}
} 

/************************** end of file *************************/
